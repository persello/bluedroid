## sdkconfig.defaults
```kconfig
# Build and flash options
CONFIG_ESPTOOLPY_FLASHSIZE_4MB=y
CONFIG_PARTITION_TABLE_CUSTOM=y
CONFIG_COMPILER_OPTIMIZATION_SIZE=y

# Bluetooth
CONFIG_BT_ENABLED=y
CONFIG_BT_BTC_TASK_STACK_SIZE=16384
CONFIG_BT_BLE_DYNAMIC_ENV_MEMORY=y
CONFIG_BT_BLE_42_FEATURES_SUPPORTED=y

# Stacks
CONFIG_ESP_IPC_TASK_STACK_SIZE=1024
CONFIG_ESP_MAIN_TASK_STACK_SIZE=8192
CONFIG_FREERTOS_IDLE_TASK_STACKSIZE=2304

# Logging
CONFIG_LOG_DEFAULT_LEVEL_INFO=y
CONFIG_LOG_TIMESTAMP_SOURCE_SYSTEM=y

# Bluetooth debugging options
CONFIG_BT_STACK_NO_LOG=y
# CONFIG_HCI_TRACE_LEVEL_VERBOSE is not set
# CONFIG_BTM_TRACE_LEVEL_VERBOSE is not set
# CONFIG_L2CAP_TRACE_LEVEL_VERBOSE is not set
# CONFIG_RFCOMM_TRACE_LEVEL_VERBOSE is not set
# CONFIG_SDP_TRACE_LEVEL_VERBOSE is not set
# CONFIG_GAP_TRACE_LEVEL_VERBOSE is not set
# CONFIG_BNEP_TRACE_LEVEL_VERBOSE is not set
# CONFIG_PAN_TRACE_LEVEL_VERBOSE is not set
# CONFIG_A2D_TRACE_LEVEL_VERBOSE is not set
# CONFIG_AVDT_TRACE_LEVEL_VERBOSE is not set
# CONFIG_AVCT_TRACE_LEVEL_VERBOSE is not set
# CONFIG_AVRC_TRACE_LEVEL_VERBOSE is not set
# CONFIG_MCA_TRACE_LEVEL_VERBOSE is not set
# CONFIG_HID_TRACE_LEVEL_VERBOSE is not set
# CONFIG_APPL_TRACE_LEVEL_VERBOSE is not set
# CONFIG_GATT_TRACE_LEVEL_VERBOSE is not set
# CONFIG_SMP_TRACE_LEVEL_VERBOSE is not set
# CONFIG_BTIF_TRACE_LEVEL_VERBOSE is not set
# CONFIG_BTC_TRACE_LEVEL_VERBOSE is not set
# CONFIG_OSI_TRACE_LEVEL_VERBOSE is not set
# CONFIG_BLUFI_TRACE_LEVEL_VERBOSE is not set
```
